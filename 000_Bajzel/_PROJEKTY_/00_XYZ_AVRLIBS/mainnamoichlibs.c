/*
 * 01_ARRAY_PINS main.c
 *
 *	    Autor: D¹browski Tomasz
 *  Stworzono: 2016-08-01
 *     Edycja: 08:28:46
 */


#include <avr/io.h>
#include <avr/pgmspace.h>
#include <stdint.h>
#include <stdlib.h>
#include <string.h>
#include <util/delay.h>
#include <stdio.h>

#include "ADDS/pins.h"
#include "ADDS/tools.h"
#include "HD44780/hd44780.h"
#include "PCD8544/pcd8544.h"
#include "DS18xxx/ds18xxx.h"

//************************** PROGRAM W£AŒCIWY - WYKORZYSTANIE ******************

THD44780 wyswT[]=
{
//			{16,2,G2O(PA,7)},
//			{16,2,G2O(PA,6)},
//			{16,4,G2O(PA,5)},
//			{20,4,G2O(PA,4)},
			{16,2,G2O(PA,7)}
};

TPCD8544 wyswG[]=
{

			{84,48,G2O(PB, 4)}

};


uint8_t nrLed;
uint16_t memo;
char buf[10];

#define blinkLED G2O(PC,0)
#define T_LEDON 300
#define T_BLINK 500  // czas pomiêdzy przejœciami pêtli g³ównej/miganiem diody
#define T_INTRO 500 // czas pomiêdzy ekranami intro
#define INTRO 0


const PROGMEM uint8_t HD44780_CHARSPLW[64]   =
{
	0x0E, 0x11, 0x11, 0x11, 0x1F, 0x11, 0x11, 0xFF, /* \0 = ¥ */
	0x02, 0x0E, 0x15, 0x10, 0x10, 0x11, 0x0E, 0x00, /* \1 = Æ */
	0x1F, 0x10, 0x10, 0x1E, 0x10, 0x10, 0x1F, 0x02, /* \2 = Ê */
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	0x04, 0x1F, 0x09, 0x02, 0x04, 0x08, 0x1F, 0x00  /* \7 =�¯ */
/*	0x1F, 0x01, 0x02, 0x1F, 0x08, 0x10, 0x1F, 0x00    \7 = ¯ */
/*	0x04, 0x1F, 0x09, 0x02, 0x04, 0x08, 0x1F, 0x00,        � */
};


/*
 * 	 small3x5.c
 *
 * Font generated by ATNEL - SFG (part of PixelFactory)
 * http://atnel.pl/pixel-factory.html
 * (C) 2015 by Atnel. Miros³aw Kardaœ
 */
#include <avr/io.h>
#include <avr/pgmspace.h>

const uint8_t small3x5[] PROGMEM = {
	0x00,0x00,0x00,                               // char    (32)
	0x00,0x00,0x00,                               // char !  (33)
	0x03,0x00,0x03,                               // char "  (34)
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	0x00,0x00,0x00,                               // char €  (128)
};

uint8_t znak[]  =
		  {
				  0b00100,
				  0b01010,
				  0b01010,
				  0b01110,
				  0b01110,
				  0b11111,
				  0b11111,
				  0b01110
		  };


uint8_t ids_count=0;
uint8_t ID[8];
uint8_t notePad[2];

uint8_t lcd,x,y;

void movecursor(uint8_t LEN)
{
	y++;
	if (y>=wyswT[lcd].LIN)
		{
		y=0;
		if (((LEN+LEN-1)+x)<(wyswT[lcd].KOL))
		{
		x+=LEN;
		}
		else
		{
		lcd++;
		if (lcd>=SIZE(wyswT)) lcd=0;
		HD44780_NR(lcd,wyswT);
			HD44780_CUSTOMCHAR(0,znak);
		x=0;
		}

		}
HD44780_XY(x,y);
}
void delayms(uint16_t ms)
{
	while(ms--)
	{
		_delay_ms(1);
	}
}

int main(void)  //rozpoczynamy
{

	OUTPUT(blinkLED);
	LOW(blinkLED);

	HD44780_START(wyswT,SIZE(wyswT));
	HD44780_NR(0,wyswT);
	HD44780_CUSTOMCHARSET(HD44780_CHARSPLW);

	//PCD8544_START(wyswG,SIZE(wyswG));
	//PCD8544_CLR();
//	PCD8544_CONTRAST(0xB1);
//	PCD8544_MODE(invert);



#if INTRO == 1
	HD44780_XY(2,0);
	HD44780_TEXT("uC-");
    HD44780_TEXT(strupr(STRING(MCU))); //HD44780_CHAR('0'+strlen(STRING(MCU)));
    HD44780_XY(2,1);
    HD44780_TEXT("@ ");
	HD44780_TEXT(STRING(F_CPU));
	HD44780_TEXT("Hz");
	_delay_ms(T_INTRO);
	HD44780_XY(0,2);
	HD44780_TEXT("RAM:");
	itoa(RAMEND-RAMSTART,buf,10);
	HD44780_TEXT(buf);
	HD44780_TEXT(" bytes");
	HD44780_XY(0,3);
	HD44780_CHAR('0'+SIZE(wyswT));
	HD44780_TEXT(strupr(" wy\x06wietlacz|ey"));
//	itoa(get_mem_unused(),buf,10);
//	itoa(RAMEND-RAMSTART,buf,10);
//	HD44780_TEXT(buf);
	_delay_ms(T_INTRO);
	HD44780_CLR();
	HD44780_CHAR('v');
	HD44780_TEXT(STRING(__DATE__));
	HD44780_XY(0,1);
	HD44780_TEXT(STRING(__TIME__));
	_delay_ms(T_INTRO);
	HD44780_NR(0,wyswT);
    HD44780_CLR();
    HD44780_TEXT(strupr("23.45\x01 35.22\x01 51.23\x03"));


#endif

    uint8_t pozycja=0;
    int8_t kierunek=1;
 uint8_t fontdata[96][8]= {
        {0b00000000, 0b00000000, 0b00000000, 0b00000000, 0b00000000, 0b00000000, 0b00000000, 0b00000000}, // [0]
        {0b00000100, 0b00000100, 0b00000100, 0b00000100, 0b00000000, 0b00000000, 0b00000100, 0b00000000}, // [1] !
        {0b00001010, 0b00001010, 0b00001010, 0b00000000, 0b00000000, 0b00000000, 0b00000000, 0b00000000}, // [2] "
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        {0b00000000, 0b00000100, 0b00001000, 0b00011111, 0b00001000, 0b00000100, 0b00000000, 0b00000000}  // [95] 
      };




    uint8_t napisek[]   =
    {
    	0x0E, 0x11, 0x11, 0x11, 0x1F, 0x11, 0x11, 0xFF, /* \0 = ¥ */
    	0x02, 0x0E, 0x15, 0x10, 0x10, 0x11, 0x0E, 0x00, /* \1 = Æ */
    	0x1F, 0x10, 0x10, 0x1E, 0x10, 0x10, 0x1F, 0x02, /* \2 = Ê */
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    	0x04, 0x1F, 0x09, 0x02, 0x04, 0x08, 0x1F, 0x00  /* \7 =�¯ */
	/*	0x1F, 0x01, 0x02, 0x1F, 0x08, 0x10, 0x1F, 0x00    \7 = ¯ */
    /*	0x04, 0x1F, 0x09, 0x02, 0x04, 0x08, 0x1F, 0x00,        � */
    };





    memcmp_P(napisek,HD44780_CHARSPLW,64);
    char *napis="POKOJMALY";
    //uint8_t dl= sizeof(napis);
  uint8_t linia[36]={0,0,0,0,0,0,0,0,0,0,0,0,0,0,0,0,0,0,0,0,0,0,0,0,0,0,0,0,0,0,0,0,0,0,0,0};
    for (uint8_t i=0; i< 9;i++)
    {
      linia[i*4]=pgm_read_byte(small3x5+(napis[i]-32)*3);
      linia[i*4+1]=pgm_read_byte(small3x5+(napis[i]-32)*3+1);
      linia[i*4+2]=pgm_read_byte(small3x5+(napis[i]-32)*3+2);
      linia[i*4+3]=0;
    }
    //HD44780_CUSTOMCHAR(1, linia+2);
    HD44780_CLR();
       HD44780_TEXT(strupr("\x08\x01\x02\x03\x04\x05\x06\x07"));
   	_delay_ms(700);
//HD44780_CUSTOMCHAR(2,znak);
    while(1) //pêtla nieskoñczona
	{

       for (uint8_t i=0;i<sizeof(napisek);i++)
       {

    	 if ((i%8!=7)) // && (i7))
    	 {
    		 napisek[i]=(napisek[i]<<1) | ((napisek[i+8]>>5) & 0x01);
    	 }
    	 else
    	 {
    		 napisek[i]=(napisek[i]<<1);
    		 HD44780_CUSTOMCHAR(i/8,&napisek[i-7]);
    	 }


       }


           //pgm_read_byte(data + i)
    	//HD44780_CUSTOMCHAR(1, linia+pozycja);


//           pozycja=pozycja+kierunek;
//    	if ((pozycja<0) || (pozycja>7*4)) kierunek=-kierunek;
			_delay_ms(20);



/* - WERYFIKACJA KODU
		ids_count=0;
		OW_RESETSEARCH();
			 while(OW_SEARCH(ID) == OW_ERR_OK)
			  {



				 ids_count++;
				 PCD8544_XY8(0,(ids_count%3)*2);
			   for (uint8_t i=0;i<8;i++)
			   		 {
				   	   	 HD44780_CHAR(NIBBLE2HEX(ID[i]>>4));
			   			 HD44780_CHAR(NIBBLE2HEX(ID[i]&0x0F));
			   			if (i>=0)
			   			{
			   			PCD8544_CHAR(NIBBLE2HEX(ID[i]>>4),normal);
			   			PCD8544_CHAR(NIBBLE2HEX(ID[i]&0x0F),normal);
			   			}
			   		 }
			   PCD8544_XY8(0,(ids_count%3)*2+1);
			   uint8_t crc=OW_CRC8(ID,7);
			   movecursor(16);
			   HD44780_CHAR(NIBBLE2HEX(crc>>4));
			   HD44780_CHAR(NIBBLE2HEX(crc&0x0F));

			   if (ID[0] == 0x28)
         		{
				 DS18xxx_STARTMEAS(ID, DS18xxx_PARASITE(ID));
				 delayms(750);
				 uint16_t temp = DS18xxx_READ_RAWTEMP(ID, EXT_POWER);

//				 uint16_t temp = 0x00FF;
				 //symulacja
//				 notePad[1]=0xFE;
//				 notePad[0]=0x6F;
				 //uint16_t temp =DS18xxx_CONVERT(ID, notePad, DS18xxx_PARASITE(ID));



			   HD44780_CHAR(0);
			   HD44780_TEXT("T");
			   HD44780_CHAR('0'+ids_count);
			   HD44780_TEXT(":");
			   HD44780_CHAR(' '+13*DS18xxxSIGN(temp));

			   PCD8544_TEXT("/T",lead1);
			   PCD8544_CHAR('0'+ids_count,lead1);
			   PCD8544_CHAR(' '+13*DS_TMPMINUS(temp),lead1);

			   itoa(DS18xxxINT(temp),buf,10);
			   HD44780_TEXT(buf);
//			   if (DS_TMPINT(temp)>99)
//				   {buf[0]='E';buf[1]='R';buf[2]=0x00;}
			   PCD8544_TEXT(buf,lead1);
			   HD44780_TEXT(".");
			   PCD8544_CHAR('.',lead1);
			   sprintf(buf,"%04d",(DS18xxxFRAC(temp)));

			   HD44780_TEXT(buf);
			   PCD8544_TEXT(buf,lead1);
			   HD44780_TEXT("P");
			   HD44780_CHAR('0'+DS18xxx_PARASITE(ID));
			   PCD8544_TEXT(" P",lead1);
			   PCD8544_CHAR('0'+DS18xxx_PARASITE(ID),lead1);

               		}
			   else
			   {
				   HD44780_TEXT("Nie termometr!");
			   }

				   movecursor(16);
                		}


//		 HD44780_TEXT("A");
//	_delay_ms(T_BLINK);
					   TOGGLE(blinkLED);




*/


	}
}


